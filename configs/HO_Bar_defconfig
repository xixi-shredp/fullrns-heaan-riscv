## configs/HO_Bar_defconfig
```kconfig
CONFIG_GEM5_RISCV=y
CONFIG_NTT_OP_HO=y
CONFIG_RVV=y
CONFIG_RVV_STATIC_SCHEDULE=y
CONFIG_DEBUG_MSG=y
# CONFIG_EN_STEP4_NTT is not set
```

## configs/HO_S4Mont_defconfig
```kconfig
CONFIG_GEM5_RISCV=y
CONFIG_NTT_OP_HO=y
CONFIG_NTT_MONT=y
CONFIG_RVV=y
CONFIG_RVV_STATIC_SCHEDULE=y
CONFIG_DEBUG_MSG=y
```
